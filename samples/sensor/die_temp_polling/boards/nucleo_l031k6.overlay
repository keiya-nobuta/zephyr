/*
 * SPDX-License-Identifier: Apache-2.0
 *
 * Copyright (c) 2023 Keiya Nobuta
 */

&die_temp {
	status = "okay";
};

&adc1 {
	pinctrl-0 = <&adc_in0_pa0>;
	pinctrl-names = "default";
	status = "okay";
};
